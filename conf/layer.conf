## conf/layer.conf
```bitbake
# We have a conf and classes directory, add to BBPATH
BBPATH .= ":${LAYERDIR}"

# We have recipes-* directories, add to BBFILES
BBFILES += "${LAYERDIR}/recipes-*/*/*.bb \
            ${LAYERDIR}/recipes-*/*/*.bbappend"

BBFILE_COLLECTIONS += "bsd"
BBFILE_PATTERN_bsd = "^${LAYERDIR}/"
BBFILE_PRIORITY_bsd = "9"
LAYERVERSION_bsd = "1"
```
